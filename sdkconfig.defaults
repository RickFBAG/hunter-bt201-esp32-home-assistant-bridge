## sdkconfig.defaults
```kconfig
CONFIG_BT_ENABLED=y
CONFIG_BT_NIMBLE_ENABLED=y
CONFIG_BT_NIMBLE_ROLE_CENTRAL=y
CONFIG_BT_NIMBLE_ROLE_OBSERVER=y
CONFIG_BT_NIMBLE_MAX_CONNECTIONS=1
CONFIG_BT_NIMBLE_PINNED_TO_CORE_0=y
CONFIG_ESP_MAIN_TASK_STACK_SIZE=6144
CONFIG_MQTT_PROTOCOL_311=y
CONFIG_LWIP_LOCAL_HOSTNAME="hunter-btt-bridge"
CONFIG_ESPTOOLPY_FLASHSIZE_8MB=y
CONFIG_ESPTOOLPY_FLASHSIZE="8MB"
CONFIG_PARTITION_TABLE_CUSTOM=y
CONFIG_PARTITION_TABLE_CUSTOM_FILENAME="partitions_bridge.csv"
CONFIG_PARTITION_TABLE_FILENAME="partitions_bridge.csv"
```
